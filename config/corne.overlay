#include <dt-bindings/zmk/matrix_transform.h>

&spi3 {
    compatible = "nordic,nrf-spim";
    status = "okay";
    pinctrl-0 = <&spi3_default>;
    pinctrl-1 = <&spi3_sleep>;
    pinctrl-names = "default", "sleep";

    led_strip: ws2812@0 {
        compatible = "worldsemi,ws2812-spi";

        /* Specs */
        reg = <0>; /* spi load periph */
        spi-max-frequency = <4000000>;

        /* WS2812B / SK6812 MINI-E */
        chain-length = <27>; /* 6 Underglow + 21 Per-Key pro Seite */
        spi-one-frame = <0x70>;
        spi-zero-frame = <0x40>;
        color-mapping = <LED_COLOR_CHANNELS_GRB>;
    };
};

/ {
    chosen {
        zmk,underglow = &led_strip;
    };
};
